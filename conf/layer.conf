## conf/layer.conf
```bitbake
# We have a conf and classes directory, add to BBPATH
BBPATH .= ":${LAYERDIR}"

# We have recipes-* directories, add to BBFILES
BBFILES += "${LAYERDIR}/recipes-*/*/*.bb \
            ${LAYERDIR}/recipes-*/*/*.bbappend"

BBFILE_COLLECTIONS += "meta-lxc-demo"
BBFILE_PATTERN_meta-lxc-demo = "^${LAYERDIR}/"
BBFILE_PRIORITY_meta-lxc-demo = "6"

LAYERDEPENDS_meta-lxc-demo = "core"
LAYERSERIES_COMPAT_meta-lxc-demo = "thud"
```
